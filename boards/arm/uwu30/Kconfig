## boards/arm/uwu30/Kconfig
```kconfig
# Copyright (c) 2025 Brandon Beltran
# SPDX-License-Identifier: MIT

config BOARD_ENABLE_DCDC
    bool "Enable DCDC mode"
    select SOC_DCDC_NRF52X
    default y
    depends on BOARD_UWU30
```

## boards/arm/uwu30/Kconfig.board
```kconfig
# Copyright (c) 2024 Brandon Beltran
# SPDX-License-Identifier: MIT

config BOARD_UWU30
    bool "uwu30"
    depends on SOC_NRF52840_QIAA
```

## boards/arm/uwu30/Kconfig.defconfig
```kconfig
# Copyright (c) 2025 Brandon Beltran
# SPDX-License-Identifier: MIT

if BOARD_UWU30

config ZMK_KEYBOARD_NAME
    default "uwu30"

config BT_CTLR
    default BT

endif # BOARD_UWU30
```
